#include <SPI.h>
#include <Wire.h>
#include <Adafruit_GFX.h>
#include <Adafruit_SSD1306.h>
#include <ESP32Servo.h>

Servo servo;
const int trig = 2, echo = 3;

int pos = 0, distcm = 0;
#define SCREEN_WIDTH 128 // OLED display width, in pixels
#define SCREEN_HEIGHT 64 // OLED display height, in pixels

#define OLED_RESET -1       // Reset pin # (or -1 if sharing Arduino reset pin)
#define SCREEN_ADDRESS 0x3C // Obtained from I2C Scanner. Look for the program in Github.
Adafruit_SSD1306 display(SCREEN_WIDTH, SCREEN_HEIGHT, &Wire, OLED_RESET);

#define SR04_TRIG_PIN 23 // GPIO pin connected to SR04 Trig pin
#define SR04_ECHO_PIN 18 // GPIO pin connected to SR04 Echo pin
#define SERVO_PIN 5      // GPIO pin connected to Servo motor

// Define the bitmap for the woman image
const unsigned char womanBitmap[] PROGMEM = {
    0xff, 0xff, 0xff, 0xff, 0xff, 0xff, 0xfe, 0x00, 0x00, 0x00, 0x1f, 0xff, 0xff, 0xff, 0xff, 0xff,
    0xff, 0xff, 0xff, 0xff, 0xff, 0xff, 0xf8, 0x00, 0x00, 0x00, 0x0f, 0xff, 0xff, 0xff, 0xff, 0xff,
    0xff, 0xff, 0xff, 0xff, 0xff, 0xff, 0xf8, 0x00, 0x00, 0x00, 0x07, 0xff, 0xff, 0xff, 0xff, 0xff,
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    0xff, 0xff, 0xff, 0xff, 0x00, 0x00, 0x00, 0x1f, 0xff, 0xfc, 0x00, 0x00, 0x03, 0xff, 0xff, 0xff

};

// Function to make the OLED displays content centered with X and Y offset
void displayCenter(String text, int X, int Y)
{
    int16_t x1;
    int16_t y1;
    uint16_t width;
    uint16_t height;

    display.getTextBounds(text, 0, 0, &x1, &y1, &width, &height);

    display.setCursor((SCREEN_WIDTH - width) / 2 + X, (SCREEN_HEIGHT - height) / 2 + Y);
    display.println(text);
}

// Function to show a message on the OLED
void showMessage(const char *message)
{
    display.clearDisplay();
    display.setTextColor(SSD1306_WHITE);
    display.setTextSize(2);
    displayCenter(message, 0, 0);
    display.display();
}

void splashScreen()
{
    display.clearDisplay();
    display.setTextColor(SSD1306_WHITE);
    display.setTextSize(1.5);
    displayCenter("EMBEDDED SYSTEM", 0, 0);
    display.display();
}

const int pinUpBtn = 0; // Changed to GPIO 0
int count = 0;
bool scanning = false;

void setup()
{
    Serial.begin(115200);

    // Setup I2C pins
    Wire.begin(21, 22); // SDA -> GPIO 21, SCL -> GPIO 22

    // Checks if the OLED is connected or not.
    if (!display.begin(SSD1306_SWITCHCAPVCC, SCREEN_ADDRESS))
    {
        Serial.println(F("SSD1306 allocation failed"));
        for (;;)
            ;
    }

    // Shows the splash screen
    splashScreen();
    delay(2000);
    display.clearDisplay();

    // Use internal pullup for button
    pinMode(SR04_TRIG_PIN, OUTPUT);
    pinMode(SR04_ECHO_PIN, INPUT);

    servo.attach(SERVO_PIN);

    display.setTextSize(1);
    display.setTextColor(SSD1306_WHITE);
    display.setCursor(7, 0);
    display.clearDisplay();
    display.println("OUR PROJECTS");
    display.setTextSize(2);
    display.setTextColor(SSD1306_WHITE);
    display.setCursor(0, 10);
    display.println("WELCOME");
    display.display();
    pinMode(pinUpBtn, INPUT_PULLUP);
    delay(3000);
}

void loop()
{
    if (!digitalRead(pinUpBtn)) // boot button - GPIO0 or GPIO_NUM_0
    {
        Serial.println("button pressed");
        if (!scanning)
        {
            if (count == 0) // boot button initially
            {
                showMessage("WELCOME");
            }
            else if (count == 1) // boot button on first press
            {
                scanning = true;
            }
            else if (count == 2) // boot button on second press
            {
                displayWomanImage(); // Display cat image
            }
            else if (count == 3) // boot button on third press
            {
                showMessage("NGUYEN DUC TIEN");
            }
            else if (count == 4) // boot button on fourth press
            {
                showMessage("THANK YOU");
            }
            else
            {
                count = -1;
            }
            count++;
            delay(200); // Debounce delay
        }
    }

    if (scanning)
    {
        for (int pos = 0; pos <= 180; pos += 1)
        {
            servo.write(pos);
            delay(50);
            displayRadarData(pos);
            if (!digitalRead(pinUpBtn))
            {
                scanning = false;
                break;
            }
        }

        for (int pos = 180; pos >= 0; pos -= 1)
        {
            servo.write(pos);
            delay(50);
            displayRadarData(pos);
            if (!digitalRead(pinUpBtn))
            {
                scanning = false;
                break;
            }
        }
    }

    vTaskDelay(50 / portTICK_PERIOD_MS);
}

void displayRadarData(int servoPos)
{
    int distance = getDistance();

    display.clearDisplay();
    display.setTextSize(1);
    display.setTextColor(SSD1306_WHITE);
    display.setCursor(0, 0);
    display.println("RADAR SCANNING..");
    display.setCursor(0, 16);
    display.println("DISTANCE       SERVO");
    display.setCursor(0, 30);
    display.println(" IN CM         DEGREE");
    display.setTextColor(SSD1306_WHITE);
    display.setCursor(0, 45);
    display.setTextSize(2);
    display.print(distance);
    display.setCursor(90, 45);
    display.setTextSize(2);
    display.print(servoPos);
    display.display();
}

void displayWomanImage()
{
    display.clearDisplay();
    display.drawBitmap(0, 0, womanBitmap, 128, 64, SSD1306_WHITE);
    display.display();
}

int getDistance()
{
    digitalWrite(SR04_TRIG_PIN, LOW);
    delayMicroseconds(5);
    digitalWrite(SR04_TRIG_PIN, HIGH);
    delayMicroseconds(10);
    digitalWrite(SR04_TRIG_PIN, LOW);

    long duration = pulseIn(SR04_ECHO_PIN, HIGH);
    int distance = duration * 0.034 / 2; // Convert to cm

    return distance;
}
